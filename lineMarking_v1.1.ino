/**
 * Line Marking Device
 * LCD:  128x64 ST7920 attached on SPI Com: SCK = en = 13, MOSI = rw = 11, CS = di = 10
 * Encoder attached on Pin 2 and Pin 3
 * Select Button on Pin 7
 * Up Button on Pin 8
 * Down Button on Pin 6
 * Relay control on Pin A1
 * Programming Option:  
 *      Board:  Arduino Uno
 *      COM:    None
 *      Wiring: Connect USB ISP Programmer
 *      Programmer: USUBtinyISP
 *      Processor: ATmega328p (5V, 16MHz)
 * EEPROM Data store for Settings
 * Author: Sohaib
 * Version: 1.0
 * Dated: 12/03/2021
 */

#include "U8glib.h"
#include <EEPROM.h>

#define  A_PHASE 2
#define  B_PHASE 3
#define PIN_BTN_SELECT 7
#define PIN_BTN_UP 8
#define PIN_BTN_DOWN 6
#define PIN_RELAY A1

#define STATE_WELCOME 0
#define STATE_HOME 1
#define STATE_SET1 2
#define STATE_SET2 3
#define STATE_SET3 4
#define STATE_SET4 5
#define STATE_SET5 6

#define ADDR_WD 0
#define ADDR_ENC 10
#define ADDR_GR 20
#define ADDR_L1 30
#define ADDR_L2 40

const unsigned char logo1 [] PROGMEM = {
    0xfc, 0xff, 0xff, 0xff, 0xff, 0xff, 0xff, 0xff, 0xff, 0xff, 0xff, 0xff,
   0xff, 0xff, 0xff, 0x3f, 0xfe, 0xff, 0xff, 0xff, 0xff, 0xff, 0xff, 0xff,
   0xff, 0xff, 0xff, 0xff, 0xff, 0xff, 0xff, 0x7f, 0xff, 0xff, 0xff, 0xff,
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   0xff, 0xff, 0xff, 0x1f
};

#define hysteresis 5 //hysteresis 5 readings, sensitivity 2mm ((wheelDia*PI)/400)*hysteresis
volatile long  flag_A = 0;  //Assign a value to the token bit

U8GLIB_ST7920_128X64_1X u8g(13, 11, 10);    // SPI Com: SCK = en = 13, MOSI = rw = 11, CS = di = 10


float wheelDia = 0.00f; //wheel diameter in mm
int encPR = 0;
float gearRatio = 0.00f;
float reqL1 = 0.00f;
float reqL2 = 0.00f;

float singleTick = ((wheelDia*PI)/(encPR*gearRatio)); //one tick lenght in mm
short count = 0;

float currValue = 0.0;

volatile unsigned int sysState = STATE_WELCOME;
volatile boolean A_set = false;
volatile boolean B_set = false;
void drawWelcome(void) {
    // graphic commands to redraw the complete screen should be placed here  
    u8g.setFont(u8g_font_unifont);
    //u8g.setFont(u8g_font_osb21);
    u8g.drawStr( 0, 22, "Welcome");
}

void setup() {
    //Serial.begin(9600);
    
    EEPROM.get(ADDR_WD, wheelDia);
    if(isnan(wheelDia)) {
        wheelDia = 200.00f;         EEPROM.put(ADDR_WD, wheelDia);
    }
    EEPROM.get(ADDR_ENC, encPR);
    if(encPR == -1) {
        encPR = 1024;               EEPROM.put(ADDR_ENC, encPR);
    }
    EEPROM.get(ADDR_GR, gearRatio);
    if(isnan(gearRatio)) {
        gearRatio = 1.00;           EEPROM.put(ADDR_GR, gearRatio);
    }
    EEPROM.get(ADDR_L1, reqL1);
    if(isnan(reqL1)) {
        reqL1 = 100.00;             EEPROM.put(ADDR_L1, reqL1);
    }
    EEPROM.get(ADDR_L2, reqL2);
    if(isnan(reqL2)) {
        reqL2 = 50.00;              EEPROM.put(ADDR_L2, reqL2);
    }
    /*
    Serial.print("wheelDia2: ");    Serial.println(wheelDia);
    Serial.print("encPR: ");        Serial.println(encPR);
    Serial.print("gearRatio: ");    Serial.println(gearRatio);
    Serial.print("reqL1: ");        Serial.println(reqL1);
    Serial.print("reqL2: ");        Serial.println(wheelDia);
    */
    
    singleTick = ((wheelDia*PI)/(encPR*gearRatio)); //one tick lenght in mm
    // assign default color value
    if ( u8g.getMode() == U8G_MODE_R3G3B2 ) {
        u8g.setColorIndex(255);     // white
    }
    else if ( u8g.getMode() == U8G_MODE_GRAY2BIT ) {
        u8g.setColorIndex(3);         // max intensity
    }
    else if ( u8g.getMode() == U8G_MODE_BW ) {
        u8g.setColorIndex(1);         // pixel on
    }
    else if ( u8g.getMode() == U8G_MODE_HICOLOR ) {
        u8g.setHiColorByRGB(255,255,255);
    }

    u8g.firstPage();
    do {
        u8g.drawXBMP( 0, 0, 128, 64, logo1);
    } while(u8g.nextPage());

    pinMode(A_PHASE, INPUT_PULLUP);
    pinMode(B_PHASE, INPUT_PULLUP);
    attachInterrupt(digitalPinToInterrupt(A_PHASE), interruptA, CHANGE); //Interrupt trigger mode: RISING
    attachInterrupt(digitalPinToInterrupt(B_PHASE), interruptB, CHANGE); //Interrupt trigger mode: RISING
    pinMode(PIN_BTN_SELECT, INPUT_PULLUP);
    pinMode(PIN_BTN_UP, INPUT_PULLUP);
    pinMode(PIN_BTN_DOWN, INPUT_PULLUP);
    pinMode(PIN_RELAY, OUTPUT);
    digitalWrite(PIN_RELAY, LOW);
}

void interruptA()// Interrupt function Phase A
{ 
    if(digitalRead(A_PHASE)) {
        A_set = true;
        if(!B_set) {
            flag_A += 1;
        }
    }
    else if(!digitalRead(A_PHASE))
        A_set = false;
}

void interruptB()// Interrupt function Phase B
{ 
    if(digitalRead(B_PHASE)) {
        B_set = true;
        if(!A_set) {
            flag_A -= 1;
            if(flag_A < 0)
                flag_A = 0;
        }
    }
    else if(!digitalRead(B_PHASE))
        B_set = false;
}

void loop() {
    switch(sysState)
    {
        case STATE_WELCOME:
        {
            //drawWelcome();
            delay(2000);
            sysState = STATE_HOME;
            break;
        }
        case STATE_HOME:
        {
            u8g.firstPage();  
            do {
                u8g.drawFrame(0, 0, 128, 64);
                 u8g.drawLine(0, 32, 128, 32);
                //u8g.drawFrame(2,2,124,60);
                u8g.setPrintPos(36, 13);        u8g.setFont(u8g_font_unifont);
                u8g.print("Current");
                currValue = float(flag_A*singleTick);
                u8g.setPrintPos(46, 29);        u8g.print(currValue, 1);
                //u8g.print(F(" mm"));
                u8g.setPrintPos(32, 45);          u8g.print("Required");

                u8g.setPrintPos(46, 61);
                if(currValue < reqL1) {
                    u8g.print(reqL1, 1);
                    digitalWrite(PIN_RELAY, LOW);
                }
                else if(currValue > reqL1 && currValue < (reqL1+reqL2)) {
                    u8g.print(reqL1+reqL2, 1);
                    digitalWrite(PIN_RELAY, HIGH);
                }
                else if(currValue > (reqL1+reqL2)) {
                    u8g.print(reqL1, 1);
                    digitalWrite(PIN_RELAY, LOW);
                    flag_A = 0;
                    currValue = float(flag_A*singleTick);
                }   
                //u8g.print(F(" mm"));
            } while(u8g.nextPage());
            if(!digitalRead(PIN_BTN_SELECT)) {
               sysState = STATE_SET1;
               delay(100);
            }
            break;
        }
        case STATE_SET1:
        {
            u8g.firstPage();  
            do {
                u8g.drawFrame(0, 0, 128, 64);
                u8g.drawLine(0, 21, 128, 21);
                u8g.setPrintPos(10,16);
                u8g.setFont(u8g_font_unifont);
                u8g.print("Settings (1/5)");
                
                u8g.setPrintPos(30, 38);            u8g.print("Wheel Dia");
                u8g.setPrintPos(33, 56);            u8g.print(float(wheelDia), 1);
                u8g.print(F(" mm"));
            } while(u8g.nextPage());
            if(digitalRead(PIN_BTN_UP)) {
                wheelDia = wheelDia + 0.1;
                delay(50);
            }
            if(digitalRead(PIN_BTN_DOWN)) {
                wheelDia = wheelDia - 0.1;
                delay(50);
            }
            if(!digitalRead(PIN_BTN_SELECT)) {
                EEPROM.put(ADDR_WD, wheelDia);
                singleTick = ((wheelDia*PI)/(encPR*gearRatio)); //one tick lenght in mm
                sysState = STATE_SET2;
                delay(100);
            }
            break;
        }
        case STATE_SET2:
        {
            u8g.firstPage();  
            do {
                u8g.drawFrame(0, 0, 128, 64);
                u8g.drawLine(0, 21, 128, 21);
                u8g.setPrintPos(10,16);
                u8g.setFont(u8g_font_unifont);
                u8g.print("Settings (2/5)");
                
                u8g.setPrintPos(35, 38);                u8g.print("Enc P/R");
                u8g.setPrintPos(48, 56);                u8g.print(encPR);
            } while(u8g.nextPage());
            if(digitalRead(PIN_BTN_UP)) {
                encPR++;
                delay(50);
            }
            if(digitalRead(PIN_BTN_DOWN)) {
                encPR--;
                delay(50);
            }
            if(!digitalRead(PIN_BTN_SELECT)) {
                EEPROM.put(ADDR_ENC, encPR);
                singleTick = ((wheelDia*PI)/(encPR*gearRatio)); //one tick lenght in mm
                sysState = STATE_SET3;
                delay(100);
            }
            break;
        }
        case STATE_SET3:
        {
            u8g.firstPage();  
            do {
                u8g.drawFrame(0, 0, 128, 64);
                u8g.drawLine(0, 21, 128, 21);
                u8g.setPrintPos(10,16);
                u8g.setFont(u8g_font_unifont);
                u8g.print("Settings (3/5)");
                
                u8g.setPrintPos(20, 38);                u8g.print("Gear Ratio");
                u8g.setPrintPos(45, 56);                u8g.print(gearRatio, 2);
            } while(u8g.nextPage());
            if(digitalRead(PIN_BTN_UP)) {
                gearRatio = gearRatio + 0.01;
                delay(50);
            }
            if(digitalRead(PIN_BTN_DOWN)) {
                gearRatio = gearRatio - 0.01;
                delay(50);
            }
            if(!digitalRead(PIN_BTN_SELECT)) {
                EEPROM.put(ADDR_GR, gearRatio);
                // Calculation based on Changed value of Gear Ratio
                singleTick = ((wheelDia*PI)/(encPR*gearRatio)); //one tick lenght in mm
                sysState = STATE_SET4;
                delay(100);
            }
            break;
        }
        case STATE_SET4:
        {
            u8g.firstPage();  
            do {
                u8g.drawFrame(0, 0, 128, 64);
                u8g.drawLine(0, 21, 128, 21);
                u8g.setPrintPos(10,16);
                u8g.setFont(u8g_font_unifont);
                u8g.print("Settings (4/5)");
                
                u8g.setPrintPos(30, 38);                u8g.print("Length 1");
                u8g.setPrintPos(33, 56);                u8g.print(reqL1, 1);
                u8g.print(F(" mm"));
            } while(u8g.nextPage());
            if(digitalRead(PIN_BTN_UP)) {
                reqL1++;
                delay(50);
            }
            if(digitalRead(PIN_BTN_DOWN)) {
                reqL1--;
                delay(50);
            }
            if(!digitalRead(PIN_BTN_SELECT)) {
                // Calculation based on Changed value of Gear Ratio
                EEPROM.put(ADDR_L1, reqL1);
                sysState = STATE_SET5;
                delay(100);
            }
            break;
        }
        case STATE_SET5:
        {
            u8g.firstPage();  
            do {
                u8g.drawFrame(0, 0, 128, 64);
                u8g.drawLine(0, 21, 128, 21);
                u8g.setPrintPos(10,16);
                u8g.setFont(u8g_font_unifont);
                u8g.print("Settings (5/5)");
                
                u8g.setPrintPos(30, 38);                u8g.print("Length 2");
                u8g.setPrintPos(33, 56);                u8g.print(reqL2, 1);
                u8g.print(F(" mm"));
            } while(u8g.nextPage());
            if(digitalRead(PIN_BTN_UP)) {
                reqL2++;
                delay(50);
            }
            if(digitalRead(PIN_BTN_DOWN)) {
                reqL2--;
                delay(50);
            }
            if(!digitalRead(PIN_BTN_SELECT)) {
                // Calculation based on Changed value of Gear Ratio
                EEPROM.put(ADDR_L2, reqL2);
                flag_A = 0;
                currValue = float(flag_A*singleTick);
                sysState = STATE_HOME;
                delay(100);
            }
            break;
        }
    }
}
